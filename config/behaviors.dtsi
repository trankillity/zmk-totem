/*                    KEY POSITIONS
      ╭────────────────────╮ ╭────────────────────╮
      │  0   1   2   3   4 │ │  5   6   7   8   9 │
  ╭───╯ 10  11  12  13  14 │ │ 15  16  17  18  19 ╰───╮
  │ 20  21  22  23  24  25 │ │ 26  27  28  29  30  31 │
  ╰───────────╮ 32  33  34 │ │ 35  36  37 ╭───────────╯
              ╰────────────╯ ╰────────────╯         */

#define KEYS_L 0 1 2 3 4 10 11 12 13 14 20 21 22 23 24 25
#define KEYS_R 5 6 7 8 9 15 16 17 18 19 26 27 28 29 30 31
#define THUMBS 32 33 34 35 36 37

/* mod morph macro */
#define MOD_MORPH(NAME, NORMAL, MODDED, MODS) \
  mm_##NAME: NAME { \
    compatible = "zmk,behavior-mod-morph"; \
    #binding-cells = <0>; \
    bindings = <&kp NORMAL>, <&kp MODDED>; \
    mods = <MODS>; \
  };

&caps_word {
    continue-list = <UNDERSCORE MINUS>;
};

&sk {
    release-after-ms = <750>;
    quick-release;
    /delete-property/ ignore-modifiers;
};

&lt {
    tapping-term-ms = <175>;
    flavor = "balanced";
};

&mmv {
    x-input-code = <INPUT_REL_X>;
    y-input-code = <INPUT_REL_Y>;
    time-to-max-speed-ms = <500>;
    acceleration-exponent = <2>;
};

/ {
    behaviors {
        hml: homerow_modsl {
            compatible = "zmk,behavior-hold-tap";
            #binding-cells = <2>;
            flavor = "balanced";
            tapping-term-ms = <200>;
            quick-tap-ms = <120>;
            require-prior-idle-ms = <300>;
            /*retro-tap;*/
            bindings = <&kp>, <&kp>;
            hold-trigger-key-positions = <KEYS_R THUMBS>;
        };

        hmr: homerow_modsr {
            compatible = "zmk,behavior-hold-tap";
            #binding-cells = <2>;
            flavor = "balanced";
            tapping-term-ms = <200>;
            quick-tap-ms = <120>;
            require-prior-idle-ms = <300>;
            /*retro-tap;*/
            bindings = <&kp>, <&kp>;
            hold-trigger-key-positions = <KEYS_L THUMBS>;
        };

        num_fun: num_function {
            compatible = "zmk,behavior-tap-dance";
            #binding-cells = <0>;
            tapping-term-ms = <250>;
            bindings = <&mo NUMB>, <&mo FUNC>;
        };

        nav_mou: navi_mous {
            compatible = "zmk,behavior-tap-dance";
            #binding-cells = <0>;
            tapping-term-ms = <250>;
            bindings = <&mo NAVI>, <&mo MOUS>;
        };

        sft_caps: shift_capsword {
            compatible = "zmk,behavior-tap-dance";
            #binding-cells = <0>;
            tapping-term-ms = <175>;
            bindings = <&sk LSHIFT>, <&caps_word>;
        };

        blconfirm: bootloader_confirmation {
            compatible = "zmk,behavior-tap-dance";
            #binding-cells = <0>;
            tapping-term-ms = <250>;
            bindings = <&none>, <&bootloader>;
        };

        MOD_MORPH(csemi, COMMA, SEMI, (MOD_LSFT|MOD_RSFT))
        MOD_MORPH(dcoln, DOT, COLON, (MOD_LSFT|MOD_RSFT))
    };
};
